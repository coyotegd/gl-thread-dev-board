## prj.conf
```kconfig
CONFIG_GPIO_SHELL=n

# NEWLIB C
CONFIG_NEWLIB_LIBC=y
CONFIG_NEWLIB_LIBC_FLOAT_PRINTF=y

# CJSON
CONFIG_CJSON_LIB=y

# Enable logging
CONFIG_LOG=y
CONFIG_GL_SENSOR_LOG_LEVEL_DBG=y
CONFIG_GL_SMP_UDP_LOG_LEVEL_DBG=y

# Peripheral Support
CONFIG_DK_LIBRARY=y

# Network Protocols
CONFIG_COAP=y

CONFIG_I2C=y
CONFIG_SENSOR=y
# CONFIG_SENSOR_LOG_LEVEL_DBG=y
CONFIG_SHTCX=y
CONFIG_HX3203=y
CONFIG_SPL0601=y

# Network shell,need to disable when enable CONFIG_MCUMGR
# CONFIG_SHELL=y
# CONFIG_SHELL_LOG_LEVEL_DBG=y

# Network settings
CONFIG_NETWORKING=y
CONFIG_NET_SOCKETS=y
CONFIG_NET_SOCKETS_POSIX_NAMES=y
CONFIG_NET_SOCKETS_POLL_MAX=4

# Link layer options
CONFIG_NET_L2_OPENTHREAD=y
CONFIG_NET_LOG=n

# OpenThread stack features
CONFIG_OPENTHREAD_DEBUG=n
CONFIG_OPENTHREAD_L2_DEBUG=n
CONFIG_OPENTHREAD_L2_LOG_LEVEL_DBG=n
CONFIG_OPENTHREAD_COAP=y
CONFIG_OPENTHREAD_DNS_CLIENT=n
CONFIG_OPENTHREAD_LEGACY=y
CONFIG_OPENTHREAD_SLAAC=y
CONFIG_OPENTHREAD_JOINER=y
CONFIG_OPENTHREAD_SRP_CLIENT=y
CONFIG_OPENTHREAD_JOINER_AUTOSTART=y
CONFIG_OPENTHREAD_JOINER_PSKD="AAAAAA"
CONFIG_OPENTHREAD_FTD=y
CONFIG_OPENTHREAD_MTD=n
CONFIG_OPENTHREAD_MTD_SED=n
CONFIG_OPENTHREAD_CHANNEL=26
# CONFIG_OPENTHREAD_PANID=39033
# CONFIG_OPENTHREAD_NETWORKKEY="8f:3a:0d:3d:20:10:44:f8:30:10:4c:d1:8e:cb:97:bd"

# CONFIG_GL_SRP_UTILS_LOG_LEVEL_DBG=y
CONFIG_GL_COAP_CLIENT_LOG_LEVEL_DBG=y
# CONFIG_GL_SMP_UDP_LOG_LEVEL_DBG=y
# CONFIG_GL_CJSON_UTILS_LOG_LEVEL_DBG=y
CONFIG_GL_OT_API_LOG_LEVEL_DBG=y

# Enable mcumgr.
CONFIG_MCUMGR=y

# Some command handlers require a large stack.
CONFIG_SYSTEM_WORKQUEUE_STACK_SIZE=2304
CONFIG_MAIN_STACK_SIZE=10240

# Ensure an MCUboot-compatible binary is generated.
CONFIG_BOOTLOADER_MCUBOOT=y
CONFIG_MCUBOOT_UTIL_LOG_LEVEL_WRN=y
CONFIG_MCUBOOT_IMAGE_VERSION="1.3.0"
CONFIG_SW_VERSION="1.3.0"

# Required by the `taskstat` command.
CONFIG_THREAD_MONITOR=y

# Support for taskstat command
CONFIG_OS_MGMT_TASKSTAT=y

# Enable statistics and statistic names.
CONFIG_STATS=y
CONFIG_STATS_NAMES=y


# Enable most core commands.
CONFIG_MCUMGR_CMD_IMG_MGMT=y
CONFIG_MCUMGR_CMD_OS_MGMT=y
CONFIG_MCUMGR_CMD_STAT_MGMT=y
# Enable the serial mcumgr transport.
CONFIG_MCUMGR_SMP_UART=y #cannot enable with CONFIG_SHELL

CONFIG_NET_MGMT=n
CONFIG_MCUMGR_SMP_UDP=y
CONFIG_MCUMGR_SMP_UDP_IPV6=y
CONFIG_NET_IPV6=y

CONFIG_SPI=y

CONFIG_LED_STRIP=y
CONFIG_WS2812_STRIP=y

CONFIG_NRFX_QDEC=y
CONFIG_QDEC_NRFX=y

CONFIG_NEWLIB_LIBC_MIN_REQUIRED_HEAP_SIZE=2048
CONFIG_THREAD_NAME=y

CONFIG_SENSOR_VALUE_AUTO_PRINT=n

CONFIG_UART_MCUMGR_RX_BUF_SIZE=1024

CONFIG_IEEE802154_VENDOR_OUI_ENABLE=y

CONFIG_IEEE802154_VENDOR_OUI=9733060

CONFIG_OPENTHREAD_LOG_LEVEL_INFO=n

#Enable ADC
CONFIG_ADC=y
```

## src/main.c
```c
/*****************************************************************************
 * @file   main.c
 * @brief  The start of application.
 *******************************************************************************
 Copyright 2022 GL-iNet. https://www.gl-inet.com/

 Licensed under the Apache License, Version 2.0 (the "License");
 you may not use this file except in compliance with the License.
 You may obtain a copy of the License at
 
 http://www.apache.org/licenses/LICENSE-2.0
 
 Unless required by applicable law or agreed to in writing, software
 distributed under the License is distributed on an "AS IS" BASIS,
 WITHOUT WARRANTIES OR CONDITIONS OF ANY KIND, either express or implied.
 See the License for the specific language governing permissions and
 limitations under the License.
 ******************************************************************************/

#include <zephyr/kernel.h>
#include <stdlib.h>
#include <dk_buttons_and_leds.h>
#include <zephyr/sys/printk.h>
#include <zephyr/logging/log.h>
#include <stdio.h>
#include <zephyr/drivers/i2c.h>
#include <zephyr/drivers/gpio.h>
#include <zephyr/drivers/pinctrl.h>
#include <zephyr/drivers/sensor.h>

#include <openthread/thread.h>
#include <openthread/instance.h>

#ifdef CONFIG_BOARD_NRF52840DONGLE_NRF52840
#include <drivers/uart.h>
#include <usb/usb_device.h>
#endif

#ifdef CONFIG_BOOTLOADER_MCUBOOT
#include <zephyr/dfu/mcuboot.h>
#endif
#ifdef CONFIG_MCUMGR_CMD_OS_MGMT
#include "os_mgmt/os_mgmt.h"
#endif
#ifdef CONFIG_MCUMGR_CMD_IMG_MGMT
#include "img_mgmt/img_mgmt.h"
#endif
#ifdef CONFIG_MCUMGR_CMD_STAT_MGMT
#include "stat_mgmt/stat_mgmt.h"
#endif
#ifdef CONFIG_MCUMGR_SMP_UDP
#include "gl_smp_udp.h"
#endif
#ifdef CONFIG_LED_STRIP
#include "gl_led_strip.h"
#endif

#include "gl_cjson_utils.h"
#include "gl_qdec.h"
#include "gl_gpio.h"
#include "gl_led.h"
#include "gl_coap.h"
#include "gl_ot_api.h"
#include "gl_sensor.h"
#include "gl_button_logic.h"
#include "gl_types.h"
#include "gl_battery.h"

LOG_MODULE_REGISTER(main, CONFIG_GL_THREAD_DEV_BOARD_LOG_LEVEL);


int joiner_state;


static void on_ot_connect(struct k_work *item)
{
	ARG_UNUSED(item);

	if (joiner_state != DEVICE_CONNECTED) {
		LOG_WRN("device connected.");
		joiner_state = DEVICE_CONNECTED;
		led_toggle_stop();
	}

	dk_set_led_on(LED2);
}

static void on_ot_disconnect(struct k_work *item)
{
	ARG_UNUSED(item);

	if (joiner_state != DEVICE_DISCONNECTED) {
		LOG_WRN("device disconnected.");
		joiner_state = DEVICE_DISCONNECTED;
		led_toggle_stop();
		led_toggle_start(1000);
	}

	dk_set_led_off(LED2);
}

static void on_mtd_mode_toggle(uint32_t med)
{
#if IS_ENABLED(CONFIG_PM_DEVICE)
	const struct device *cons = device_get_binding(CONSOLE_LABEL);

	if (med) {
		pm_device_action_run(cons, PM_DEVICE_ACTION_RESUME);
	} else {
		pm_device_action_run(cons, PM_DEVICE_ACTION_SUSPEND);
	}
#endif
	dk_set_led(LED2, med);
}

static struct k_work  qdec_work;
static struct k_timer qdec_idle_timer;
static volatile int32_t qdec_accum       = 0;
static volatile bool    qdec_send_pending = false;

#define QDEC_IDLE_MS 1000

/* ── Encoder LED mode state ─────────────────────────────────────────────
 * encoder_mode cycles on each button press of the rotary encoder:
 *   0 = LED1 hue       1 = LED1 brightness
 *   2 = LED2 hue       3 = LED2 brightness
 *
 * QDEC returns degrees; steps=60 in DTS means one full rotation = 360°.
 * Hue  : hue_deg += sv.val1  →  360° sweep = full rainbow in one turn.
 * Brightness: delta = sv.val1 * 254 / 360  →  360° = full 1-255 range.
 * ────────────────────────────────────────────────────────────────────── */
static uint8_t          encoder_mode      = 0;
static int16_t          led_hue_deg[2]    = {0, 0};  /* per-LED hue [0,359] */
static uint8_t          led_bri[2]        = {255, 255}; /* per-LED brightness */
static volatile int32_t led_pending_steps = 0;
static struct k_work    led_encoder_work;

/* Integer HSV→RGB.  S=1, V=1.  hue_deg in [0,360). */
static void hsv_to_rgb(int hue_deg, uint8_t *r, uint8_t *g, uint8_t *b)
{
	hue_deg = ((hue_deg % 360) + 360) % 360;
	int sector = hue_deg / 60;
	int frac   = (hue_deg % 60) * 255 / 60;
	int q      = 255 - frac;
	switch (sector) {
	case 0: *r = 255;  *g = frac; *b = 0;    break;
	case 1: *r = q;    *g = 255;  *b = 0;    break;
	case 2: *r = 0;    *g = 255;  *b = frac; break;
	case 3: *r = 0;    *g = q;    *b = 255;  break;
	case 4: *r = frac; *g = 0;    *b = 255;  break;
	default:*r = 255;  *g = 0;    *b = q;    break;
	}
}

static void qdec_idle_expiry(struct k_timer *timer)
{
	ARG_UNUSED(timer);
	k_work_submit(&qdec_work);
}

static void qdec_trigger(struct k_work *item)
{
	ARG_UNUSED(item);

	/* Atomically capture and clear the accumulator. */
	unsigned int key = irq_lock();
	int32_t total    = qdec_accum;
	qdec_accum       = 0;
	qdec_send_pending = true;
	irq_unlock(key);

	if (total != 0) {
		double val = (double)total;
		send_trigger_event_request(QDEC_ROTATE_TRIGGER, "qdec_0", (void *)&val);
	}

	qdec_send_pending = false;
}

/* Called from gl_button_logic.c on each BTN4 press.
 * Cycles encoder_mode 0→1→2→3→4(off)→0 and controls the active LED.
 * Mode 4 turns both LEDs off.  Re-entering mode 0 resets both brightness
 * to 50% so the user gets a clean start after powering back on. */
void encoder_mode_cycle(void)
{
	encoder_mode = (encoder_mode + 1) % 5;
	static const char *const mode_names[] = {
		"LED1 color", "LED1 brightness",
		"LED2 color", "LED2 brightness",
		"all off",
	};
	printk("Encoder mode: %s\n", mode_names[encoder_mode]);
	if (encoder_mode == 4) {
		on_off_led_strip(LED_STRIP_NODE_1, LED_OFF);
		on_off_led_strip(LED_STRIP_NODE_2, LED_OFF);
	} else {
		if (encoder_mode == 0) {
			/* Returning from OFF — set both strips to 50% */
			led_bri[0] = 127;
			led_bri[1] = 127;
			set_led_strip_brightness(LED_STRIP_NODE_1, 127);
			set_led_strip_brightness(LED_STRIP_NODE_2, 127);
		}
		uint16_t node = (encoder_mode < 2) ? LED_STRIP_NODE_1 : LED_STRIP_NODE_2;
		on_off_led_strip(node, LED_ON);
	}
}

/* System-workqueue handler — applies accumulated encoder steps to the
 * active LED's hue or brightness and refreshes the hardware. */
static void led_encoder_apply(struct k_work *item)
{
	ARG_UNUSED(item);

	unsigned int key = irq_lock();
	int32_t steps    = led_pending_steps;
	led_pending_steps = 0;
	irq_unlock(key);

	if (steps == 0) {
		return;
	}

	if (encoder_mode == 4) {
		return; /* all-off mode — ignore rotation */
	}

	uint8_t  led_idx = (encoder_mode < 2) ? 0 : 1;
	uint16_t node    = (encoder_mode < 2) ? LED_STRIP_NODE_1 : LED_STRIP_NODE_2;
	bool     is_hue  = (encoder_mode == 0 || encoder_mode == 2);

	if (is_hue) {
		/* QDEC degrees map 1:1 to hue; one full rotation = full rainbow */
		int32_t new_hue = (int32_t)led_hue_deg[led_idx] + steps;
		new_hue = ((new_hue % 360) + 360) % 360;
		led_hue_deg[led_idx] = (int16_t)new_hue;

		uint8_t r, g, b;
		hsv_to_rgb(led_hue_deg[led_idx], &r, &g, &b);
		struct led_rgb color = { .r = r, .g = g, .b = b };
		update_led_strip_rgb(node, &color);
	} else {
		/* one full rotation (360°) = full brightness range 0-255 */
		int32_t delta   = steps * 255 / 360;
		int32_t new_bri = (int32_t)led_bri[led_idx] + delta;
		if (new_bri < 0)   { new_bri = 0; }
		if (new_bri > 255) { new_bri = 255; }
		led_bri[led_idx] = (uint8_t)new_bri;
		set_led_strip_brightness(node, led_bri[led_idx]);
		on_off_led_strip(node, led_bri[led_idx] == 0 ? LED_OFF : LED_ON);
		return;
	}

	on_off_led_strip(node, LED_ON);
}

void encoder_callback(const struct device *dev, const struct sensor_trigger *trigger)
{
	if (qdec_send_pending) {
		return;
	}

	struct sensor_value sv;
	sensor_sample_fetch(dev);
	sensor_channel_get(dev, SENSOR_CHAN_ROTATION, &sv);

	unsigned int key = irq_lock();
	led_pending_steps += sv.val1;
	qdec_accum        += sv.val1;
	/* Anti-windup: once at a brightness limit, stop accumulating steps
	 * in the same direction so the first step the other way takes effect. */
	if (encoder_mode == 1 || encoder_mode == 3) {
		uint8_t idx = (encoder_mode == 1) ? 0 : 1;
		if (led_bri[idx] >= 255 && led_pending_steps > 0) { led_pending_steps = 0; }
		if (led_bri[idx] == 0   && led_pending_steps < 0) { led_pending_steps = 0; }
	}
	irq_unlock(key);

	k_work_submit(&led_encoder_work);
	/* Restart idle timer — fires QDEC_IDLE_MS after the last step. */
	k_timer_start(&qdec_idle_timer, K_MSEC(QDEC_IDLE_MS), K_NO_WAIT);
}

void print_version(void)
{
	printk("{\"Board\":\"%s\"}\n", CONFIG_BOARD);
	printk("{\"SW_Version\":\"%s\"}\n", CONFIG_SW_VERSION);
	printk("OpenThread Stack: %s\n", otGetVersionString());
	printk("OpenThread Mode: %s\n", ot_get_mode());
}

void simulation_click(uint32_t button)
{
	on_button_changed(0xFFFF, button);
	on_button_changed(0xFFFF, button);
}

void auto_join_commissioning_start()
{
	simulation_click(DK_BTN2_MSK);
}

void main(void)
{
	print_version();

	int ret;

#ifdef CONFIG_MCUMGR_CMD_OS_MGMT
	os_mgmt_register_group();
#endif
#ifdef CONFIG_MCUMGR_CMD_IMG_MGMT
	img_mgmt_register_group();
#endif
#ifdef CONFIG_MCUMGR_CMD_STAT_MGMT
	stat_mgmt_register_group();
#endif

	ret = gl_gpio_init();
	if (ret) {
		LOG_ERR("Could not initialize gpios, err code: %d", ret);
	}

	ret = dk_leds_init();
	if (ret) {
		LOG_ERR("Could not initialize leds, err code: %d", ret);
	}
	light_off();

	ret = dk_buttons_init(on_button_changed);
	if (ret) {
		LOG_ERR("Cannot init buttons (error: %d)", ret);
	}

	ret = battery_measure_enable(true);
	if (ret) {
		LOG_ERR("Could not initialize battery measurement, err code: %d", ret);
	}

#ifdef CONFIG_BOOTLOADER_MCUBOOT
	/* Check if the image is run in the REVERT mode and eventually
	 * confirm it to prevent reverting on the next boot.
	 */
	if (mcuboot_swap_type() == BOOT_SWAP_TYPE_REVERT) {
		if (boot_write_img_confirmed()) {
			LOG_ERR("Confirming firmware image failed, it will be reverted on the next boot.");
		} else {
			LOG_INF("New device firmware image confirmed.");
		}
	}
#endif

	joiner_state = DEVICE_INITIAL;

	gl_sensor_init();

	coap_client_utils_init(on_ot_connect, on_ot_disconnect, on_mtd_mode_toggle);
	// auto_commissioning_timer_init();
	auto_join_commissioning_start();

#ifdef CONFIG_SENSOR_VALUE_AUTO_PRINT
	debug_sensor_data();
#endif
	gl_led_strip_init();

	k_work_init(&qdec_work, qdec_trigger);
	k_work_init(&led_encoder_work, led_encoder_apply);
	k_timer_init(&qdec_idle_timer, qdec_idle_expiry, NULL);
	gl_qdec_init(encoder_callback);

	return ;
}
```

## src/gl_button_logic.c
```c
/*****************************************************************************
 * @file  gl_button_logic.c
 * @brief Provides button related functions.
 *******************************************************************************
 Copyright 2022 GL-iNet. https://www.gl-inet.com/

 Licensed under the Apache License, Version 2.0 (the "License");
 you may not use this file except in compliance with the License.
 You may obtain a copy of the License at
 
 http://www.apache.org/licenses/LICENSE-2.0
 
 Unless required by applicable law or agreed to in writing, software
 distributed under the License is distributed on an "AS IS" BASIS,
 WITHOUT WARRANTIES OR CONDITIONS OF ANY KIND, either express or implied.
 See the License for the specific language governing permissions and
 limitations under the License.
 ******************************************************************************/

#include <zephyr/kernel.h>
#include <zephyr/drivers/gpio.h>
#include <zephyr/devicetree.h>
#include <zephyr/device.h>
#include <dk_buttons_and_leds.h>
#include <zephyr/logging/log.h>
#include <openthread/thread.h>

#include "gl_types.h"
#include "gl_led.h"
#include "gl_coap.h"
#include "gl_ot_api.h"
#include "gl_srp_utils.h"

LOG_MODULE_REGISTER(button_logic, CONFIG_GL_THREAD_DEV_BOARD_LOG_LEVEL);

#define SW0_NODE DT_ALIAS(sw0)
#define SW1_NODE DT_ALIAS(sw1)
const struct gpio_dt_spec SW1 = GPIO_DT_SPEC_GET_OR(SW0_NODE, gpios, { 0 });
const struct gpio_dt_spec SW2 = GPIO_DT_SPEC_GET_OR(SW1_NODE, gpios, { 0 });

extern int joiner_state;
extern void encoder_mode_cycle(void);
uint32_t join_time_start;


void on_button_changed(uint32_t button_state, uint32_t has_changed)
{
	static bool is_sw2_press, is_sw2_release;
	static uint32_t sw2_time_start;
	uint32_t sw2_time_end = 0;

	static bool is_sw1_press, is_sw1_release;
	static uint32_t sw1_time_start;
	uint32_t sw1_time_end = 0;

	uint32_t buttons = button_state & has_changed;

	if(buttons & DK_BTN1_MSK) { // Press
		is_sw1_press = true;
		sw1_time_start = k_uptime_get_32();
	}else if (buttons & DK_BTN2_MSK) { // Press
		is_sw2_press = true;
		sw2_time_start = k_uptime_get_32();
	} 

	if (is_sw1_press) {
		if (gpio_pin_get_dt(&SW1) == 0) { // Release
			is_sw1_release = true;
			sw1_time_end = k_uptime_get_32();
		}
	}

	if (is_sw2_press) {
		if (gpio_pin_get_dt(&SW2) == 0) { // Release
			is_sw2_release = true;
			sw2_time_end = k_uptime_get_32();
		}
	}

	if (is_sw1_press && is_sw1_release) {
		printk("Button1\n");
		if ((sw1_time_end - sw1_time_start) < 300) { // update the status
			LOG_INF("Updating status...");
			coap_client_send_status();
			ot_print_network_info();
		} else { // Testing mode
			LOG_INF("Start testing mode...");
			start_testing_mode();
		}
		is_sw1_press = false;
		is_sw1_release = false;

	}else if (is_sw2_press && is_sw2_release) {
		printk("Button2\n");
		if ((sw2_time_end - sw2_time_start) < 300) { // Joining
			join_time_start = k_uptime_get_32();
			if (joiner_state != DEVICE_CONNECTED) {
				if (ot_start() == 0) {
					joiner_state = DEVICE_CONNECTING;
					led_toggle_start(200);
					LOG_INF("Joining start...");
				}
			}
			is_sw2_press = false;
			is_sw2_release = false;
		} else if ((sw2_time_end - sw2_time_start) > 3000) { // Factoryreset
			LOG_INF("Factoryreset start...");
#ifdef CONFIG_OPENTHREAD_SRP_CLIENT
			srp_utils_host_remove();
#endif
			k_sleep(K_MSEC(1000));
			ot_factoryreset();
		}
	} else if (buttons & DK_BTN3_MSK) {
		printk("Button3 Press\n");
		send_trigger_event_request(INFRARED_SENSOR_TRIGGER, "infra_0", "trigger");

	} else if (buttons & DK_BTN4_MSK) {
		printk("Button4 Press\n");
		encoder_mode_cycle();
		send_trigger_event_request(QDEC_BUTTON_TRIGGER, "qdec_0", "trigger");
	}
}
```

## src/gl_types.h
```c
/*****************************************************************************
 * @file  gl_type.h
 * @brief Define various types.
 *******************************************************************************
 Copyright 2022 GL-iNet. https://www.gl-inet.com/

 Licensed under the Apache License, Version 2.0 (the "License");
 you may not use this file except in compliance with the License.
 You may obtain a copy of the License at
 
 http://www.apache.org/licenses/LICENSE-2.0
 
 Unless required by applicable law or agreed to in writing, software
 distributed under the License is distributed on an "AS IS" BASIS,
 WITHOUT WARRANTIES OR CONDITIONS OF ANY KIND, either express or implied.
 See the License for the specific language governing permissions and
 limitations under the License.
 ******************************************************************************/

#ifndef _GL_TYPES_H_
#define _GL_TYPES_H_

#ifndef ARRAY_SIZE
#define ARRAY_SIZE(x) (sizeof(x) / sizeof((x)[0]))
#endif

enum { 
    ERROR_CODE_UNKNOW = -3,
    ERROR_CODE_NO_BUFS = -2, 
    ERROR_CODE_INVALID_PARAMETER = -1, 
    ERROR_CODE_NONE = 0 
};

enum { 
    CONFIG_CMD_ON_OFF = 0, 
    CONFIG_CMD_UPGRADE, 
    CONFIG_CMD_FACTORYRESET, 
    CONFIG_CMD_REBOOT,
    CONFIG_CMD_CHANGE_COLOR,
    CONFIG_CMD_SET_GPIO,
    CONFIG_CMD_GET_LED_STATUS,
    CONFIG_CMD_GET_GPIO_STATUS,
    CONFIG_CMD_SET_REPORT_INTERVAL,
    CONFIG_CMD_SET_OT_MODE,
    CONFIG_CMD_SET_LEVEL
};

enum { 
    CONFIG_OBJ_LED_STRIP_NODE_ALL = 0,
    CONFIG_OBJ_LED_STRIP_NODE_LEFT = 1,
    CONFIG_OBJ_LED_STRIP_NODE_RIGHT = 2   
};



enum { DEVICE_INITIAL = 0, DEVICE_CONNECTING = 1, DEVICE_CONNECTED = 2, DEVICE_DISCONNECTED = 3 };

#endif /* _GL_TYPES_H_ */
```
